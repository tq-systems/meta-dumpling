## conf/distro/dumpling-rzg2.conf
```bitbake
require conf/distro/dumpling.inc
require tq-provider-rzg2.inc

DISTRO = "dumpling-rzg2"
DISTRO_NAME = "Dumpling (TQ-Systems Dumpling Distribution) for TQ-Systems RZG2 BSP"
```

## conf/distro/dumpling-wayland-rzg2.conf
```bitbake
require dumpling-rzg2.conf

DISTRO = "dumpling-wayland-rzg2"
DISTRO_NAME = "Dumpling Wayland (TQ-Systems Dumpling Wayland Distribution) for TQ-Systems RZG2 BSP"

#
# Imported from meta-renesas/docs/sample/conf/*/local.conf
#

# Enable wayland and disable x11
DISTRO_FEATURES_append = " wayland"

# Enable pam distro feature
DISTRO_FEATURES_append = " pam"

#
# End of imported options
#
```

## conf/distro/tq-provider-rzg2.inc
```bitbake
# Select CIP Core packages by switching betwwen Buster and Bullseye.
#  - Buster (default)	: build all supported Debian 10 Buster recipes
#  - Bullseye		: build all supported Debian 11 Bullseye recipes
#  - Not set (or different with above): not use CIP Core, use default packages version in Yocto

CIP_MODE = "Buster"

# The rensas layer uses a fixed string "/home/root" to install some
# examples/helpers to the root home dir. For convenience set ROOT_HOME
# accordingly.
ROOT_HOME = "/home/root"
```

## conf/layer.conf
```bitbake
# We have a conf and classes directory, add to BBPATH
BBPATH .= ":${LAYERDIR}"

# We have recipes-* directories, add to BBFILES
BBFILES += "${LAYERDIR}/recipes-*/*/*.bb \
	${LAYERDIR}/recipes-*/*/*.bbappend"

BBFILE_COLLECTIONS += "dumpling"
BBFILE_PATTERN_dumpling = "^${LAYERDIR}/"
BBFILE_PRIORITY_dumpling = "7"

LAYERDEPENDS_dumpling = "core tq-layer"
LAYERSERIES_COMPAT_dumpling = "sumo"

# The dynamic-layers directory hosts the extensions and layer specific
# modifications related to TQ Embedded products.
#
BBFILES_DYNAMIC += " \
         qt5-layer:${LAYERDIR}/dynamic-layers/qt5-layer/recipes-*/*/*.bbappend \
         qt5-layer:${LAYERDIR}/dynamic-layers/qt5-layer/recipes-*/*/*.bb \
         fsl-bsp-release:${LAYERDIR}/dynamic-layers/fsl-bsp-release/recipes-*/*/*.bbappend \
         fsl-bsp-release:${LAYERDIR}/dynamic-layers/fsl-bsp-release/recipes-*/*/*.bb \
         fsl-demos:${LAYERDIR}/dynamic-layers/fsl-demos/recipes-*/*/*.bbappend \
         fsl-demos:${LAYERDIR}/dynamic-layers/fsl-demos/recipes-*/*/*.bb \
"

# HACKHACKHACK
PACKAGECONFIG_remove_pn-gstreamer1.0-plugins-bad = " opencv "
RDEPENDS_packagegroup-fsl-tools-gpu-external_remove_imxgpu = " opencv-samples opencv "

# PREFERRED_VERSION_gstreamer1.0-plugins-bad  = "1.12.2"
```
